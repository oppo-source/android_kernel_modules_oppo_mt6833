## kernel/build/kernel/kleaf/impl/defconfig/kasan_generic_defconfig
```kconfig
CONFIG_KASAN=y
CONFIG_KCOV=y
CONFIG_KCOV_ENABLE_COMPARISONS=y
# CONFIG_MODULE_SIG_PROTECT is not set
CONFIG_KASAN_INLINE=y
CONFIG_KASAN_STACK=y
CONFIG_FRAME_WARN=0
CONFIG_KASAN_GENERIC=y
# CONFIG_KASAN_HW_TAGS is not set
# CONFIG_KASAN_SW_TAGS is not set
```

## kernel/build/kernel/kleaf/impl/defconfig/ubsan_defconfig
```kconfig
CONFIG_UBSAN=y
CONFIG_UBSAN_ARRAY_BOUNDS=y
CONFIG_UBSAN_LOCAL_BOUNDS=y
CONFIG_UBSAN_SHIFT=y
CONFIG_UBSAN_UNREACHABLE=y
CONFIG_UBSAN_BOOL=y
CONFIG_UBSAN_ENUM=y
CONFIG_UBSAN_TRAP=y
```

## kernel/kernel_device_modules-6.6/drivers/misc/mediatek/aw37004/Kconfig
```kconfig
config LDO_AW37004
	tristate "CAMERA_LDO_AW37004 for MT6877"
	help
	  This is a driver for the MediaTek
	  image sensors.
	  To compile this driver as a module, choose M here: the
	  module will be called CAMERA_LDO_AW37004.
```

## kernel/kernel_device_modules-6.6/drivers/misc/mediatek/pmic_ldo_set/Kconfig
```kconfig
config CAMERA_PMIC_ENABLE
	tristate "CAMERA_PMIC_ENABLE for MT6877"
	help
	  This is a driver for the MediaTek
	  image sensors.
	  To compile this driver as a module, choose M here: the
	  module will be called CAMERA_PMIC_ENABLE.
```

## kernel/kernel_device_modules-6.6/drivers/misc/mediatek/sensor/1.0/Kconfig
```kconfig
# SPDX-License-Identifier: GPL-2.0

menu "Sensors"

config MTK_SENSOR_ARCHITECTURE
	string "MTK SENSOR ARCHITECTURE"
	default "dummy"
	help
	  Sensor config for sensor architecture in project.
	  Please set 1.0/2.0/3.0 etc if you want to support sensor
	  with mediatek sensor architecture.
	  If unsure, set dummy.

config OPLUS_FEATURE_SENSOR
	bool "oplus feature sensor config"
	default n
        help
          oplus feature sensor flag added for support kernel sensor

endmenu # Sensors

source "$(KCONFIG_EXT_PREFIX)drivers/misc/mediatek/sensor/1.0/accelerometer/Kconfig"
source "$(KCONFIG_EXT_PREFIX)drivers/misc/mediatek/sensor/1.0/alsps/Kconfig"
source "$(KCONFIG_EXT_PREFIX)drivers/misc/mediatek/sensor/1.0/gyroscope/Kconfig"
source "$(KCONFIG_EXT_PREFIX)drivers/misc/mediatek/sensor/1.0/magnetometer/Kconfig"
source "$(KCONFIG_EXT_PREFIX)drivers/misc/mediatek/sensor/1.0/hwmon/Kconfig"
source "$(KCONFIG_EXT_PREFIX)drivers/misc/mediatek/sensor/1.0/barometer/Kconfig"
source "$(KCONFIG_EXT_PREFIX)drivers/misc/mediatek/sensor/1.0/step_counter/Kconfig"
source "$(KCONFIG_EXT_PREFIX)drivers/misc/mediatek/sensor/1.0/situation/Kconfig"
source "$(KCONFIG_EXT_PREFIX)drivers/misc/mediatek/sensor/1.0/sensorHub/Kconfig"
source "$(KCONFIG_EXT_PREFIX)drivers/misc/mediatek/sensor/1.0/sensorfusion/Kconfig"
source "$(KCONFIG_EXT_PREFIX)drivers/misc/mediatek/sensor/1.0/rear_als/Kconfig"
source "$(KCONFIG_EXT_PREFIX)drivers/misc/mediatek/sensor/1.0/rear_flicker/Kconfig"
```

## kernel/kernel_device_modules-6.6/drivers/misc/mediatek/sensor/1.0/rear_als/Kconfig
```kconfig
config CUSTOM_KERNEL_REAR_ALS
	bool "CUSTOM KERNEL REAR ALS Config"
	help
	  one load to support different rear_als sensor.
	  This feature Option is used for projects which using more than one
	  rear_als, and be auto detected by setting this option to yes
	  If unsure, say N.

source "$(KCONFIG_EXT_PREFIX)drivers/misc/mediatek/sensor/1.0/rear_als/rear_alshub/Kconfig"
```

## kernel/kernel_device_modules-6.6/drivers/power/Kconfig
```kconfig
# SPDX-License-Identifier: GPL-2.0-only
#source "drivers/power/reset/Kconfig"
#source "drivers/power/supply/Kconfig"
#ifdef OPLUS_FEATURE_CHG_BASIC

config OPLUS_PD_EXT_SUPPORT
	bool "TypeC Port Controller Extern"
	default n
	help
	  Say Y to enable

source "$(KCONFIG_EXT_PREFIX)drivers/power/oplus/Kconfig"

source "$(KCONFIG_EXT_PREFIX)drivers/power/oplus/pd_ext/Kconfig"
#endif
```

## vendor/oplus/kernel/cpu/Kconfig
```kconfig
# SPDX-License-Identifier: GPL-2.0-only
# Copyright (C) 2018-2022 Oplus. All rights reserved.

config OPLUS_FEATURE_CPU
	bool "oplus cpu feature"
    default n
	help
	  Add for CPU Feature

source "$(KCONFIG_EXT_PREFIX)kernel/oplus_cpu/cpufreq_health/Kconfig"
source "$(KCONFIG_EXT_PREFIX)kernel/oplus_cpu/cpufreq_bouncing/Kconfig"
source "$(KCONFIG_EXT_PREFIX)kernel/oplus_cpu/sched/Kconfig"
source "$(KCONFIG_EXT_PREFIX)kernel/oplus_cpu/uad/Kconfig"
source "$(KCONFIG_EXT_PREFIX)kernel/oplus_cpu/oplus_slc/Kconfig"
source "$(KCONFIG_EXT_PREFIX)kernel/oplus_cpu/oplus_omrg/Kconfig"
source "$(KCONFIG_EXT_PREFIX)kernel/oplus_cpu/oplus_overload/Kconfig"
source "$(KCONFIG_EXT_PREFIX)kernel/oplus_cpu/waker_identify/Kconfig"
source "$(KCONFIG_EXT_PREFIX)kernel/oplus_cpu/oplus_game/Kconfig"
```

## vendor/oplus/kernel/cpu/oplus_game/Kconfig
```kconfig
config OPLUS_FEATURE_GAME_ENABLE
	bool "enable game features by chipset"
	default n
	help
	  use this macro to enable game feature by chipset.

config OPLUS_FEATURE_CPU_GAME
	tristate "OPLUS GAME module specific"
	default n
	help
	  oplus game module. Features from oplus game team can be added here.

config MTK_ENGINE_COOLER_DISABLE
	bool "disable mtk_game features by chipset"
	default n
	help
	  use this macro to disable mtk_game feature by chipset.
```

## vendor/oplus/kernel/graphics/Kconfig
```kconfig
# SPDX-License-Identifier: GPL-2.0-only
# Copyright (C) 2020-2022 Oplus. All rights reserved.

config OPLUS_SYNC_FENCE
	bool "Enable oplus sync fence"
	help
	  Enable sync_fence driver
```

## vendor/oplus/kernel/misc/mtk_oplus_gpio/Kconfig
```kconfig
#change 'm' to 'n', if you want fo close this controller
config OPLUS_GPIO
    tristate "oplus gpio controller"
    default n
    help
      define this config to control oplus gpio.
```

## vendor/oplus/kernel/oplus_performance/sched_assist/Kconfig
```kconfig
config OPLUS_FEATURE_SCHED_ASSIST
	tristate "sched_assist"
	default n
	help
	  turning sched for ui, render and so on to improve UX
config OPLUS_FEATURE_SCHED_SPREAD
	bool "sched_spread"
	default n
	help
	  This is the uifirst 5.0 feature, which will spread tasks,
	  kick runnable time from task demand and adjust bg's time slice.
config OPLUS_UX_IM_FLAG
	bool "config ux im_flag"
	default n
	help
	  export im_flag proc node for mark thread.
config OPLUS_FEATURE_AUDIO_OPT
        bool "config audio opt"
        default n
        help
          audio task schedule opt
config MMAP_LOCK_OPT
        bool "config mmap lock opt"
        default n
        depends on OPLUS_FEATURE_SCHED_ASSIST
        help
          reduce sleep time in mmap lock
config OPLUS_ALLBOOST_OPT
        bool "config allboost opt"
        default n
        help
          Make the SCHED_ALL_BOOST function take effect
config OPLUS_FG_BOOST
        bool "config oplus fg boost"
        default n
        help
          Make the SCHED_FG_BOOST function take effect

config OPLUS_CPU_AUDIO_PERF
	tristate "boost audio task in scheduler"
	default n
        depends on OPLUS_UX_IM_FLAG
	help
	   Choose this option to enable scheduler boost for audio task.

config OPLUS_LOCKING_STRATEGY
	bool "config monitor&juc locking optimation"
	depends on OPLUS_FEATURE_SCHED_ASSIST
	default n
	help
	  monitor&juc locking optimation.

config OPLUS_LOCKING_OSQ
	bool "osq control"
	depends on OPLUS_LOCKING_STRATEGY
	default n
	help
	  Customized mutex & rwsem osq logic.

config OPLUS_LOCKING_MONITOR
	bool "locking stats monitor"
	depends on OPLUS_LOCKING_STRATEGY
	default n
	help
	  Tracing kernel-lock statistics.

config OPLUS_INTERNAL_VERSION
	bool "internal version"
	depends on OPLUS_LOCKING_MONITOR
	default n
	help
	  Support more tracing-types in internal version.

config OPLUS_FEATURE_EAS_OPT
	tristate "eas opt"
	default n
	help
	  control fake_cap, iowait_protect

config OPLUS_FEATURE_FAKE_CAP
	tristate "fake cap"
	default n
	depends on OPLUS_FEATURE_EAS_OPT
	help
	  fake cap can influence task placement

config OPLUS_CPUFREQ_IOWAIT_PROTECT
	tristate "cpufreq_iowait"
	default n
	depends on OPLUS_FEATURE_EAS_OPT
	help
	  ensure iowait decay not happen too quickly
```

## vendor/oplus/kernel/touchpanel/oplus_touchscreen/Kconfig
```kconfig
config TOUCHPANEL_MTK_PLATFORM
	bool "OPLUS platform tp module used"
	help
	  Say Y here if you have mtk-platform.

config TOUCHPANEL_LATE_INIT
	bool "mk6360 pmic init"
	help
	  Say Y here if you have mk6360 pmic.

config TOUCHIRQ_UPDATE_QOS
	bool "OPLUS touchpanel driver update qos"
	help
	  Say Y here if you want to update qos value in irq handler.

config TOUCHPANEL_NEW_SET_IRQ_WAKE
	bool "OPLUS platform tp module used"
	help
	  Say Y here if call enable_irq_wake, can not call disable_irq_nosync

config TOUCHPANEL_OPLUS
	bool "OPLUS tp module"
	help
	  Say Y here if you have touchscreen module.

config OPLUS_TP_APK
	bool "OPLUS apk node create"
	help
	  Say Y here if you use apk for TP.

config TOUCHPANEL_MULTI_NOFLASH
	bool "Multiple noflash TPs using"
	help
	  Say Y here if you have multiple noflash touchscreen.

config TOUCHPANEL_SYNAPTICS
#	default y
	bool "TP Synaptics_IC enable or not for OPLUS"
	---help---
	say Y to enable driver for Touchpanel using Synaptics_IC

config TOUCHPANEL_GOODIX
#	default y
	bool "TP Synaptics_IC enable or not for OPLUS"
	---help---
	say Y to enable driver for Touchpanel using GOODIX_IC

config TOUCHPANEL_NOVA
#	default y
	bool "TP Nova_IC enable or not for OPLUS"
	---help---
	say Y to enable driver for Touchpanel using NOVATECK_IC

config TOUCHPANEL_ILITEK
#	default y
	bool "TP ilitek IC enable or not for OPLUS"
	---help---
	say Y to enable driver for Touchpanel using ilitek IC

config TOUCHPANEL_CHIPONE
#	default y
	bool "TP chipone IC enable or not for OPLUS"
	---help---
	say Y to enable driver for Touchpanel using chipone IC

source "drivers/input/touchscreen/oplus_touchscreen/util_interface/Kconfig"

if TOUCHPANEL_SYNAPTICS
source "drivers/input/touchscreen/oplus_touchscreen/Synaptics/Kconfig"
endif

if TOUCHPANEL_GOODIX
source "drivers/input/touchscreen/oplus_touchscreen/Goodix/Kconfig"
endif

if TOUCHPANEL_NOVA
source "drivers/input/touchscreen/oplus_touchscreen/Novatek/Kconfig"
endif

if TOUCHPANEL_ILITEK
source "drivers/input/touchscreen/oplus_touchscreen/ilitek/Kconfig"
endif
```
