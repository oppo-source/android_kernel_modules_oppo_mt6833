## kernel/kernel_device_modules-6.6/Kconfig.ext
```kconfig
# SPDX-License-Identifier: GPL-2.0

config DEVICE_MODULES_ALLOW_BUILTIN
	bool "allow builtin drivers into kernel image"
	help
	  All modules are default built as kernel modules.
	  Set DEVICE_MODULES_ALLOW_BUILTIN=y to build modules
	  into the kernel image.
	  If unsure, say N.

source "$(KCONFIG_EXT_PREFIX)drivers/memory/Kconfig"

source "$(KCONFIG_EXT_PREFIX)drivers/iio/adc/Kconfig"

source "$(KCONFIG_EXT_PREFIX)drivers/mfd/Kconfig"

source "$(KCONFIG_EXT_PREFIX)drivers/nvmem/Kconfig"

source "$(KCONFIG_EXT_PREFIX)drivers/dma/mediatek/Kconfig"

source "$(KCONFIG_EXT_PREFIX)drivers/ufs/Kconfig"

source "$(KCONFIG_EXT_PREFIX)drivers/char/Kconfig"

source "$(KCONFIG_EXT_PREFIX)drivers/clk/mediatek/Kconfig"

source "$(KCONFIG_EXT_PREFIX)drivers/clocksource/Kconfig"

source "$(KCONFIG_EXT_PREFIX)drivers/cpufreq/Kconfig"

source "$(KCONFIG_EXT_PREFIX)drivers/soc/mediatek/Kconfig"

source "$(KCONFIG_EXT_PREFIX)drivers/watchdog/Kconfig"

source "$(KCONFIG_EXT_PREFIX)drivers/dma-buf/heaps/Kconfig"

source "$(KCONFIG_EXT_PREFIX)drivers/regulator/Kconfig"

source "$(KCONFIG_EXT_PREFIX)drivers/leds/Kconfig"

source "$(KCONFIG_EXT_PREFIX)drivers/pinctrl/mediatek/Kconfig"

source "$(KCONFIG_EXT_PREFIX)drivers/power/supply/Kconfig"

source "$(KCONFIG_EXT_PREFIX)drivers/power/Kconfig"

source "$(KCONFIG_EXT_PREFIX)drivers/rtc/Kconfig"

source "$(KCONFIG_EXT_PREFIX)drivers/remoteproc/Kconfig"

source "$(KCONFIG_EXT_PREFIX)drivers/rpmsg/Kconfig"

source "$(KCONFIG_EXT_PREFIX)drivers/input/keyboard/Kconfig"

source "$(KCONFIG_EXT_PREFIX)drivers/phy/mediatek/Kconfig"

source "$(KCONFIG_EXT_PREFIX)drivers/thermal/mediatek/Kconfig"

source "$(KCONFIG_EXT_PREFIX)drivers/spmi/Kconfig"

source "$(KCONFIG_EXT_PREFIX)drivers/tty/serial/8250/Kconfig"

source "$(KCONFIG_EXT_PREFIX)drivers/reset/Kconfig"

source "$(KCONFIG_EXT_PREFIX)drivers/mailbox/Kconfig"

source "$(KCONFIG_EXT_PREFIX)drivers/interconnect/Kconfig"

source "$(KCONFIG_EXT_PREFIX)drivers/i2c/busses/Kconfig"

source "$(KCONFIG_EXT_PREFIX)drivers/i3c/master/Kconfig"

source "$(KCONFIG_EXT_PREFIX)drivers/pwm/Kconfig"

source "$(KCONFIG_EXT_PREFIX)drivers/spi/Kconfig"

source "$(KCONFIG_EXT_PREFIX)drivers/iommu/Kconfig"

source "$(KCONFIG_EXT_PREFIX)drivers/tee/Kconfig"

source "$(KCONFIG_EXT_PREFIX)drivers/mmc/host/Kconfig"

source "$(KCONFIG_EXT_PREFIX)drivers/gpu/drm/mediatek/Kconfig"

source "$(KCONFIG_EXT_PREFIX)drivers/input/touchscreen/Kconfig"

source "$(KCONFIG_EXT_PREFIX)drivers/gpu/drm/panel/Kconfig"

source "$(KCONFIG_EXT_PREFIX)drivers/gpu/drm/bridge/Kconfig"

source "$(KCONFIG_EXT_PREFIX)drivers/gpu/mediatek/Kconfig"

source "$(KCONFIG_EXT_PREFIX)drivers/media/platform/Kconfig"

source "$(KCONFIG_EXT_PREFIX)drivers/usb/Kconfig"

source "$(KCONFIG_EXT_PREFIX)drivers/net/ethernet/stmicro/Kconfig"

source "$(KCONFIG_EXT_PREFIX)drivers/net/phy/Kconfig"

source "$(KCONFIG_EXT_PREFIX)drivers/devfreq/Kconfig"

source "$(KCONFIG_EXT_PREFIX)drivers/misc/mediatek/Kconfig"

source "$(KCONFIG_EXT_PREFIX)sound/soc/codecs/Kconfig"

source "$(KCONFIG_EXT_PREFIX)sound/soc/mediatek/Kconfig"

source "$(KCONFIG_EXT_PREFIX)sound/virtio/Kconfig"

source "$(KCONFIG_EXT_PREFIX)drivers/pci/controller/Kconfig"

source "$(KCONFIG_EXT_PREFIX)drivers/pinctrl/Kconfig"

source "$(KCONFIG_EXT_PREFIX)drivers/media/platform/mtk-isp/Kconfig"

source "$(KCONFIG_EXT_PREFIX)drivers/soc/oplus/oplus_mm_fb/Kconfig"

source "$(KCONFIG_EXT_PREFIX)drivers/soc/oplus/boot/Kconfig"

source "$(KCONFIG_EXT_PREFIX)drivers/soc/oplus/boot/oplus_projectinfo/Kconfig"

source "$(KCONFIG_EXT_PREFIX)drivers/soc/oplus/boot/cmdline_parser/Kconfig"

source "$(KCONFIG_EXT_PREFIX)drivers/soc/oplus/boot/oplus_custom/Kconfig"

source "$(KCONFIG_EXT_PREFIX)fs/f2fs/Kconfig"

source "$(KCONFIG_EXT_PREFIX)arch/arm/Kconfig"

source "$(KCONFIG_EXT_PREFIX)drivers/soc/oplus/device_info/Kconfig"

source "$(KCONFIG_EXT_PREFIX)drivers/soc/oplus/storage/common/ufs_oplus_dbg/Kconfig"

source "$(KCONFIG_EXT_PREFIX)drivers/base/kernelFwUpdate/Kconfig"

source "$(KCONFIG_EXT_PREFIX)drivers/misc/oplus/oplus_gpio/Kconfig"

source "$(KCONFIG_EXT_PREFIX)drivers/base/touchpanel_notify/Kconfig"

source "$(KCONFIG_EXT_PREFIX)drivers/misc/oplus/vibrator/aw8697_haptic/Kconfig"

source "$(KCONFIG_EXT_PREFIX)drivers/misc/oplus/sim_detect/Kconfig"

source "$(KCONFIG_EXT_PREFIX)drivers/input/fingerprint/Kconfig"

source "$(KCONFIG_EXT_PREFIX)drivers/hypervisor/guest/Kconfig"

source "$(KCONFIG_EXT_PREFIX)drivers/hypervisor/host/Kconfig"

source "$(KCONFIG_EXT_PREFIX)drivers/hypervisor/nebula/Kconfig"

source "$(KCONFIG_EXT_PREFIX)drivers/oplus_inject/Kconfig"

source "$(KCONFIG_EXT_PREFIX)drivers/misc/oplus/cs_press/Kconfig"

source "$(KCONFIG_EXT_PREFIX)drivers/soc/oplus/dft/common/olc/Kconfig"

source "$(KCONFIG_EXT_PREFIX)drivers/soc/oplus/dft/common/feedback/Kconfig"

source "$(KCONFIG_EXT_PREFIX)drivers/soc/oplus/storage/common/io_metrics/Kconfig"

source "$(KCONFIG_EXT_PREFIX)/drivers/video/backlight/Kconfig"

source "$(KCONFIG_EXT_PREFIX)kernel/oplus_cpu/Kconfig"

source "$(KCONFIG_EXT_PREFIX)drivers/base/magtransfer/Kconfig"

source "$(KCONFIG_EXT_PREFIX)drivers/soc/oplus/storage/common/storage_log/Kconfig"

source "$(KCONFIG_EXT_PREFIX)drivers/soc/oplus/storage/common/oplus_uprobe/Kconfig"

source "$(KCONFIG_EXT_PREFIX)drivers/soc/oplus/storage/common/oplus_f2fslog_storage/Kconfig"

source "$(KCONFIG_EXT_PREFIX)drivers/soc/oplus/storage/common/wq_dynamic_priority/Kconfig"

source "$(KCONFIG_EXT_PREFIX)drivers/misc/mediatek/pmic_ldo_set/Kconfig"

source "$(KCONFIG_EXT_PREFIX)drivers/misc/mediatek/sensor/2.0/oplus_sensor_devinfo/Kconfig"

source "$(KCONFIG_EXT_PREFIX)drivers/misc/mediatek/sensor/2.0/oplus_consumer_ir/Kconfig"

source "$(KCONFIG_EXT_PREFIX)drivers/misc/mediatek/sensor/2.0/oplus_virtual_sensor/Kconfig"

source "$(KCONFIG_EXT_PREFIX)drivers/misc/mediatek/sensor/2.0/oplus_virtual_sensor/platform/sensor_cmd/Kconfig"

source "$(KCONFIG_EXT_PREFIX)drivers/misc/mediatek/sensor/2.0/oplus_virtual_sensor/platform/sensor_device/Kconfig"

source "$(KCONFIG_EXT_PREFIX)drivers/misc/mediatek/sensor/2.0/oplus_virtual_sensor/platform/sensor_event/Kconfig"

source "$(KCONFIG_EXT_PREFIX)drivers/misc/mediatek/sensor/2.0/oplus_virtual_sensor/sensors/lux_aodhub/Kconfig"

source "$(KCONFIG_EXT_PREFIX)drivers/misc/mediatek/sensor/2.0/oplus_virtual_sensor/sensors/fp_displayhub/Kconfig"

source "$(KCONFIG_EXT_PREFIX)drivers/misc/mediatek/sensor/2.0/oplus_virtual_sensor/sensors/pickup_detecthub/Kconfig"

source "$(KCONFIG_EXT_PREFIX)drivers/misc/mediatek/sensor/2.0/oplus_virtual_sensor/sensors/pedo_minutehub/Kconfig"
source "$(KCONFIG_EXT_PREFIX)drivers/misc/mediatek/aw37004/Kconfig"

source "$(KCONFIG_EXT_PREFIX)drivers/misc/mediatek/sensor/2.0/oplus_virtual_sensor/sensors/back_tap_detecthub/Kconfig"

source "$(KCONFIG_EXT_PREFIX)drivers/misc/mediatek/sensor/2.0/oplus_virtual_sensor/sensors/phone_proxhub/Kconfig"

source "$(KCONFIG_EXT_PREFIX)drivers/misc/mediatek/sensor/2.0/oplus_virtual_sensor/sensors/gesture_proxhub/Kconfig"

source "$(KCONFIG_EXT_PREFIX)drivers/misc/mediatek/sensor/2.0/oplus_virtual_sensor/sensors/ambiente_proxhub/Kconfig"

source "$(KCONFIG_EXT_PREFIX)drivers/misc/mediatek/sensor/2.0/oplus_virtual_sensor/sensors/lay_detecthub/Kconfig"

source "$(KCONFIG_EXT_PREFIX)drivers/misc/mediatek/sensor/2.0/oplus_virtual_sensor/sensors/palm_detecthub/Kconfig"

source "$(KCONFIG_EXT_PREFIX)drivers/misc/mediatek/sensor/2.0/oplus_virtual_sensor/sensors/oplus_activity_recognitionhub/Kconfig"

source "$(KCONFIG_EXT_PREFIX)drivers/misc/mediatek/sensor/2.0/oplus_virtual_sensor/sensors/elevator_detecthub/Kconfig"

source "$(KCONFIG_EXT_PREFIX)drivers/misc/mediatek/sensor/1.0/oplus_sensor_devinfo/Kconfig"

source "$(KCONFIG_EXT_PREFIX)drivers/misc/mediatek/sensor/1.0/oplus_virtual_sensor/Kconfig"

source "$(KCONFIG_EXT_PREFIX)drivers/misc/mediatek/sensor/1.0/oplus_virtual_sensor/platform/sensor_cmd/Kconfig"

source "$(KCONFIG_EXT_PREFIX)drivers/misc/mediatek/sensor/1.0/oplus_virtual_sensor/platform/sensor_device/Kconfig"

source "$(KCONFIG_EXT_PREFIX)drivers/misc/mediatek/sensor/1.0/oplus_virtual_sensor/platform/sensor_event/Kconfig"

source "$(KCONFIG_EXT_PREFIX)drivers/misc/mediatek/sensor/1.0/oplus_virtual_sensor/sensors/lux_aodhub/Kconfig"

source "$(KCONFIG_EXT_PREFIX)drivers/misc/mediatek/sensor/1.0/oplus_virtual_sensor/sensors/fp_displayhub/Kconfig"

source "$(KCONFIG_EXT_PREFIX)drivers/misc/mediatek/sensor/1.0/oplus_virtual_sensor/sensors/pickup_detecthub/Kconfig"

source "$(KCONFIG_EXT_PREFIX)drivers/misc/mediatek/sensor/1.0/oplus_virtual_sensor/sensors/palm_detecthub/Kconfig"

source "$(KCONFIG_EXT_PREFIX)drivers/misc/mediatek/sensor/1.0/oplus_virtual_sensor/sensors/back_tap_detecthub/Kconfig"

source "$(KCONFIG_EXT_PREFIX)drivers/misc/mediatek/sensor/2.0/oplus_virtual_sensor/sensors/back_tap_detecthub/Kconfig"

source "$(KCONFIG_EXT_PREFIX)drivers/misc/mediatek/sensor/2.0/oplus_virtual_sensor/sensors/rotation_detecthub/Kconfig"

source "$(KCONFIG_EXT_PREFIX)drivers/misc/mediatek/sensor/1.0/oplus_virtual_sensor/sensors/pedo_minutehub/Kconfig"
```

## vendor/oplus/kernel/camera/flashlight/v4l2/Kconfig
```kconfig
config OPLUS_VIDEO_AW36515
	tristate "AW36515 dual flash driver support"
	depends on I2C && VIDEO_DEV && MEDIA_CONTROLLER
	depends on MEDIA_CAMERA_SUPPORT
	select REGMAP_I2C
	help
	  This is a driver for the AW36515 dual flash controllers. It controls
	  flash, torch LEDs.

	  Say Y here if you want a flashlight driver IC LM3644.
	  Select this only if your board has this IC.
	  Say M here if you want to compile this driver as a module.

config OPLUS_VIDEO_AW36515_OMEGAS2
	tristate "AW36515 dual flash driver support"
	depends on I2C && VIDEO_DEV && MEDIA_CONTROLLER
	depends on MEDIA_CAMERA_SUPPORT
	select REGMAP_I2C
	help
	  This is a driver for the AW36515_OMEGAS2 dual flash controllers. It controls
	  flash, torch LEDs.

	  Say Y here if you want a flashlight driver IC LM3644.
	  Select this only if your board has this IC.
	  Say M here if you want to compile this driver as a module.

config OPLUS_VIDEO_AW36515_OMEGAS3
	tristate "AW36515 dual flash driver support"
	depends on I2C && VIDEO_DEV && MEDIA_CONTROLLER
	depends on MEDIA_CAMERA_SUPPORT
	select REGMAP_I2C
	help
	  This is a driver for the AW36515_OMEGAS3 dual flash controllers. It controls
	  flash, torch LEDs.

	  Say Y here if you want a flashlight driver IC LM3644.
	  Select this only if your board has this IC.
	  Say M here if you want to compile this driver as a module.

config OPLUS_VIDEO_AW36515_BRZA
	tristate "AW36515 dual flash driver support"
	depends on I2C && VIDEO_DEV && MEDIA_CONTROLLER
	depends on MEDIA_CAMERA_SUPPORT
	select REGMAP_I2C
	help
	  This is a driver for the AW36515_BRZA dual flash controllers. It controls
	  flash, torch LEDs.

	  Say Y here if you want a flashlight driver IC AW36515.
	  Select this only if your board has this IC.
	  Say M here if you want to compile this driver as a module.
```

## vendor/oplus/kernel/camera/regulator/Kconfig
```kconfig
config PMIC_WL2868C
	tristate "Fairchild WL2868C PMIC"
	depends on I2C && (OF || COMPILE_TEST)
	select REGMAP_I2C
	help
	  This driver supports Fairchild (ON Semiconductor) WL2868C
	  regulator. The regulator is a programmable power management IC
	  (PMIC), it is controlled by I2C and provides LDO outputs

config PMIC_AW37004DNR
        tristate "awinic aw37004dnr PMIC"
        depends on I2C && (OF || COMPILE_TEST)
        select REGMAP_I2C
        help
          This driver supports awinic (shanghai awinic) aw37004dnr
          regulator. The regulator is a programmable power management IC
          (PMIC), it is controlled by I2C and provides LDO outputs.
```
