// SPDX-License-Identifier: GPL-2.0
/* Copyright (c) 2023 MediaTek Inc. */

&soc {

	//#ifdef OPLUS_FEATURE_POWER_THERMAL
	shell_front {
		compatible = "oplus,shell-temp";
	};

	shell_frame {
		compatible = "oplus,shell-temp";
	};

	shell_back {
		compatible = "oplus,shell-temp";
	};
//#endif /* OPLUS_FEATURE_POWER_THERMAL */
};