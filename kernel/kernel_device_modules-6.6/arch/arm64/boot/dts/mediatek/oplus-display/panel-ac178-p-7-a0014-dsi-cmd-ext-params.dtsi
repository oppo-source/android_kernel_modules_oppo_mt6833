&dsi0 {
	dsc_params: oplus,dsc_params {
		enable               = <1>;
		ver                  = <18>;
		slice_mode           = <1>;
		rgb_swap             = <0>;
		dsc_cfg              = <40>;
		rct_on               = <1>;
		bit_per_channel      = <10>;
		dsc_line_buf_depth   = <11>;
		bp_enable            = <1>;
		bit_per_pixel        = <128>;
		pic_height           = <2760>;
		pic_width            = <1256>;
		slice_height         = <12>;
		slice_width          = <628>;
		chunk_size           = <628>;
		xmit_delay           = <512>;
		dec_delay            = <571>;
		scale_value          = <32>;
		increment_interval   = <309>;
		decrement_interval   = <8>;
		line_bpg_offset      = <12>;
		nfl_bpg_offset       = <2235>;
		slice_bpg_offset     = <1860>;
		initial_offset       = <6144>;
		final_offset         = <4336>;
		flatness_minqp       = <7>;
		flatness_maxqp       = <16>;
		rc_model_size        = <8192>;
		rc_edge_factor       = <6>;
		rc_quant_incr_limit0 = <15>;
		rc_quant_incr_limit1 = <15>;
		rc_tgt_offset_hi     = <3>;
		rc_tgt_offset_lo     = <3>;
	};
	#include "panel-ac178-p-7-a0014-dsi-cmd-spr.dtsi"
};