// SPDX-License-Identifier: GPL-2.0-only
/*
* Copyright (C) 2021-2020 Oplus. All rights reserved.
*/
#include <dt-bindings/iio/mt635x-auxadc.h>
#include <dt-bindings/pinctrl/mt6991-pinfunc.h>
#include <dt-bindings/pinctrl/mt65xx.h>

&peak_power_budget {
	compatible = "mediatek,peak_power_budget";
	bootmode = <&chosen>;
	gauge = <&mtk_gauge>;
	reg = <0 0x00117700 0 0x100>,
		<0 0x13020170 0 0xc>,
		<0 0x4b840c18 0 0x8>,
		<0 0x0c220c04 0 0x20>;
	reg-names = "ppb_sram",
		"hpt_ctrl","gpu_dbg", "cpu_dbg";

	ppb-version = <2>;
	soc-error = <500>;
	battery-circult-rdc  = <37>;
	battery0-path-rac-t0 = <55>;
	battery0-path-rac-t1 = <57>;
	battery0-path-rac-t2 = <61>;
	battery0-path-rac-t3 = <63>;
	battery1-path-rac-t0 = <55>;
	battery1-path-rac-t1 = <57>;
	battery1-path-rac-t2 = <61>;
	battery1-path-rac-t3 = <63>;
	battery2-path-rac-t0 = <55>;
	battery2-path-rac-t1 = <57>;
	battery2-path-rac-t2 = <61>;
	battery2-path-rac-t3 = <63>;
	temperature-threshold = <25 10 0>;
	system-ocp = <15000>;
	system-uvlo = <2400>;

	soc-max-level = <2>;
	soc-hpt-ctrl-lv1 = <7>;
	soc-hpt-ctrl-lv2 = <0>;

	bat-ocv-table-num = <6>;
	bat0-ocv-table-t0-temperature = <50>;
		bat0-ocv-table-t0-qmax = <5846>;
	bat0-ocv-table-t0-size = <100>;
	bat0-ocv-table-t0 = <
		0	44556	0 	329
			591		44387	101 	329
			1181	44255	202 	327
			1772	44150	303 	336
			2362	44051	404 	341
			2953	43953	505 	342
			3543	43856	606 	344
			4134	43758	707 	337
			4724	43658	808 	340
			5315	43558	909 	348
			5905	43457	1010 	347
			6496	43349	1111 	358
			7086	43253	1212 	384
			7677	43131	1313 	347
			8267	43016	1414 	346
			8858	42900	1515 	359
			9448	42779	1616 	346
			10039	42660	1717 	334
			10629	42541	1818 	359
			11220	42419	1919 	359
			11810	42300	2020 	359
			12401	42175	2121 	362
			12991	42057	2222 	365
			13582	41935	2323 	374
			14172	41815	2424 	375
			14763	41695	2525 	372
			15353	41573	2626 	375
			15944	41457	2727 	389
			16534	41343	2828 	399
			17125	41229	2929 	405
			17715	41113	3030 	422
			18306	40997	3131 	437
			18896	40880	3232 	451
			19487	40745	3333 	452
			20077	40563	3434 	417
			20668	40360	3535 	361
			21258	40207	3636 	350
			21849	40086	3737 	344
			22439	39980	3838 	348
			23030	39877	3939 	344
			23620	39786	4040 	342
			24211	39693	4141 	342
			24801	39604	4242 	342
			25392	39518	4343 	354
			25982	39435	4444 	344
			26573	39352	4546 	356
			27163	39266	4646 	342
			27754	39193	4748 	344
			28344	39119	4848 	358
			28935	39045	4950 	359
			29525	38973	5050 	361
			30116	38909	5152 	374
			30706	38838	5252 	390
			31297	38770	5354 	390
			31887	38700	5454 	418
			32478	38583	5556 	351
			33068	38446	5657 	330
			33659	38338	5758 	360
			34249	38240	5859 	359
			34840	38154	5960 	359
			35430	38056	6061 	345
			36021	37970	6162 	359
			36611	37890	6263 	357
			37202	37811	6364 	374
			37792	37719	6465 	374
			38383	37611	6566 	381
			38973	37505	6667 	375
			39564	37406	6768 	373
			40154	37307	6869 	401
			40745	37199	6970 	389
			41335	37132	7071 	374
			41926	37085	7172 	378
			42516	37039	7273 	375
			43107	37000	7374 	389
			43697	36948	7475 	426
			44288	36861	7576 	480
			44878	36736	7677 	666
			45469	36628	7778 	775
			46059	36504	7879 	775
			46650	36369	7980 	815
			47240	36222	8081 	825
			47831	36064	8182 	860
			48421	35889	8283 	892
			49012	35706	8384 	939
			49602	35509	8485 	976
			50193	35313	8586 	1031
			50783	35124	8687 	1096
			51374	34934	8788 	1157
			51964	34746	8889 	1100
			52555	34546	8990 	1000
			53145	34332	9091 	1000
			53736	34098	9192 	950
			54326	33828	9293 	800
			54917	33533	9394 	750
			55507	33211	9495 	600
			56098	32878	9596 	550
			56688	32547	9697 	500
			57279	32186	9798 	310
			57869	31747	9899 	310
			58460	31082	10000 	310
			>;
		bat0-ocv-table-t1-temperature = <25>;
		bat0-ocv-table-t1-qmax = <5887>;
		bat0-ocv-table-t1-size = <100>;
		bat0-ocv-table-t1 = <
			0		44680	0 		509
			595		44504	101 	532
			1189	44366	202 	525
			1784	44258	303 	520
			2379	44163	404 	540
			2973	44065	505 	541
			3568	43966	606 	543
			4163	43874	707 	557
			4757	43776	808 	544
			5352	43675	909 	551
			5946	43574	1010 	555
			6541	43466	1111 	532
			7136	43360	1212 	528
			7730	43250	1313 	542
			8325	43139	1414 	554
			8920	43023	1515 	550
			9514	42908	1616 	562
			10109	42787	1717 	557
			10704	42668	1818 	557
			11298	42547	1919 	569
			11893	42422	2020 	569
			12488	42298	2121 	550
			13082	42179	2222 	579
			13677	42057	2323 	587
			14272	41938	2424 	599
			14866	41811	2525 	604
			15461	41692	2626 	613
			16055	41572	2727 	605
			16650	41455	2828 	626
			17245	41339	2929 	652
			17839	41223	3030 	666
			18434	41106	3131 	697
			19029	40993	3232 	704
			19623	40879	3333 	729
			20218	40738	3434 	736
			20813	40555	3535 	669
			21407	40339	3636 	575
			22002	40178	3737 	557
			22597	40047	3838 	533
			23191	39937	3939 	528
			23786	39841	4040 	536
			24381	39746	4141 	527
			24975	39654	4242 	527
			25570	39567	4343 	539
			26164	39478	4444 	521
			26759	39400	4545 	536
			27354	39314	4647 	531
			27948	39240	4747 	542
			28543	39162	4848 	535
			29138	39093	4950 	559
			29732	39021	5050 	550
			30327	38952	5152 	562
			30922	38880	5253 	563
			31516	38821	5353 	588
			32111	38750	5455 	572
			32706	38686	5556 	592
			33300	38608	5657 	574
			33895	38513	5758 	554
			34489	38410	5859 	530
			35084	38320	5960 	539
			35679	38232	6061 	542
			36273	38136	6162 	533
			36868	38048	6263 	524
			37463	37969	6364 	527
			38057	37888	6465 	541
			38652	37793	6566 	534
			39247	37686	6667 	544
			39841	37578	6768 	542
			40436	37483	6869 	573
			41031	37373	6970 	564
			41625	37263	7071 	560
			42220	37195	7172 	533
			42815	37154	7273 	542
			43409	37111	7374 	542
			44004	37069	7475 	542
			44598	37019	7576 	583
			45193	36923	7677 	655
			45788	36779	7778 	891
			46382	36659	7879 	988
			46977	36534	7980 	1002
			47572	36391	8081 	1015
			48166	36236	8182 	1051
			48761	36065	8283 	1084
			49356	35894	8384 	1000
			49950	35696	8485 	1000
			50545	35495	8586 	1000
			51140	35293	8687 	1000
			51734	35095	8788 	1000
			52329	34900	8889 	1000
			52924	34696	8990 	1000
			53518	34485	9091 	1000
			54113	34243	9192 	980
			54707	33972	9293 	900
			55302	33680	9394 	800
			55897	33348	9495 	750
			56491	33017	9596 	700
			57086	32673	9697 	600
			57681	32323	9798 	500
			58275	31923	9899 	500
			58870	31374	10000 	500
			>;

		bat0-ocv-table-t2-temperature = <10>;
		bat0-ocv-table-t2-qmax = <5738>;
		bat0-ocv-table-t2-size = <100>;
		bat0-ocv-table-t2 = <
			0		44717	0 		1125
			580		44511	101 	1130
			1159	44377	202 	1138
			1739	44264	303 	1122
			2318	44165	404 	1123
			2898	44074	505 	1108
			3478	43983	606 	1108
			4057	43892	707 	1107
			4637	43796	808 	1105
			5216	43693	909 	1090
			5796	43596	1010 	1080
			6376	43494	1111 	1077
			6955	43395	1212 	1068
			7535	43289	1313 	1072
			8114	43181	1414 	1075
			8694	43068	1515 	1075
			9274	42950	1616 	1063
			9853	42833	1717 	1075
			10433	42714	1818 	1060
			11012	42596	1919 	1069
			11592	42475	2020 	1075
			12172	42353	2121 	1075
			12751	42234	2222 	1077
			13331	42113	2323 	1090
			13910	41993	2424 	1090
			14490	41871	2525 	1112
			15069	41753	2626 	1110
			15649	41634	2727 	1137
			16229	41512	2828 	1126
			16808	41399	2929 	1157
			17388	41286	3030 	1168
			17967	41165	3131 	1173
			18547	41053	3232 	1207
			19127	40936	3333 	1230
			19706	40812	3434 	1231
			20286	40677	3535 	1231
			20865	40509	3636 	1195
			21445	40313	3737 	1086
			22025	40141	3838 	997
			22604	40005	3939 	973
			23184	39887	4040 	961
			23763	39783	4141 	962
			24343	39684	4242 	937
			24923	39594	4343 	940
			25502	39511	4444 	967
			26082	39426	4545 	958
			26661	39342	4646 	950
			27241	39263	4747 	951
			27821	39191	4849 	965
			28400	39113	4949 	956
			28980	39045	5051 	977
			29559	38970	5151 	950
			30139	38907	5253 	973
			30719	38837	5354 	965
			31298	38774	5455 	975
			31878	38716	5556 	996
			32457	38647	5657 	989
			33037	38591	5758 	997
			33617	38521	5859 	997
			34196	38458	5960 	995
			34776	38386	6061 	988
			35355	38314	6162 	997
			35935	38219	6263 	950
			36515	38125	6364 	938
			37094	38040	6465 	941
			37674	37959	6566 	956
			38253	37878	6667 	965
			38833	37786	6768 	966
			39413	37684	6869 	967
			39992	37575	6970 	967
			40572	37479	7071 	967
			41151	37377	7172 	981
			41731	37269	7273 	995
			42311	37187	7374 	972
			42890	37142	7475 	982
			43470	37104	7576 	997
			44049	37059	7677 	987
			44629	37017	7778 	1030
			45208	36941	7879 	1052
			45788	36795	7980 	1150
			46368	36641	8081 	1150
			46947	36511	8182 	1150
			47527	36381	8283 	1350
			48106	36231	8384 	1400
			48686	36069	8485 	1400
			49266	35893	8586 	1400
			49845	35699	8687 	1300
			50425	35492	8788 	1250
			51004	35285	8889 	1250
			51584	35076	8990 	1100
			52164	34869	9091 	1100
			52743	34658	9192 	1000
			53323	34442	9293 	1000
			53902	34210	9394 	1000
			54482	33950	9495 	1000
			55062	33667	9596 	800
			55641	33355	9697 	800
			56221	33028	9798 	700
			56800	32694	9899 	700
			57380	32390	10000 	700
			>;

		bat0-ocv-table-t3-temperature = <0>;
		bat0-ocv-table-t3-qmax = <5549>;
		bat0-ocv-table-t3-size = <100>;
		bat0-ocv-table-t3 = <
			0		44797	0 		2477
			561		44562	101 	2483
			1121	44408	202 	2465
			1682	44293	303 	2476
			2242	44196	404 	2471
			2803	44098	505 	2447
			3363	44012	606 	2450
			3924	43918	707 	2432
			4484	43830	808 	2429
			5045	43737	909 	2423
			5605	43639	1010 	2400
			6166	43547	1111 	2409
			6726	43448	1212 	2400
			7287	43346	1313 	2391
			7847	43244	1414 	2398
			8408	43137	1515 	2385
			8968	43027	1616 	2375
			9529	42918	1717 	2373
			10089	42810	1818 	2382
			10650	42692	1919 	2378
			11210	42573	2020 	2353
			11771	42460	2121 	2369
			12331	42342	2222 	2367
			12892	42228	2323 	2379
			13452	42109	2424 	2377
			14013	41991	2525 	2370
			14573	41878	2626 	2376
			15134	41761	2727 	2381
			15694	41645	2828 	2408
			16255	41531	2929 	2373
			16815	41415	3030 	2343
			17376	41306	3131 	2313
			17936	41189	3232 	2283
			18497	41069	3333 	2200
			19057	40948	3434 	2120
			19618	40821	3535 	2040
			20178	40678	3636 	1960
			20739	40512	3737 	1880
			21299	40339	3838 	1800
			21860	40185	3939 	1800
			22420	40052	4040 	1800
			22981	39928	4141 	1800
			23541	39847	4242 	1800
			24102	39772	4343 	1800
			24662	39691	4444 	1800
			25223	39611	4546 	1800
			25783	39532	4646 	1800
			26344	39454	4748 	1800
			26904	39383	4848 	1800
			27465	39307	4950 	1800
			28025	39238	5050 	1800
			28586	39163	5152 	1800
			29146	39098	5252 	1800
			29707	39025	5354 	1800
			30267	38964	5454 	1800
			30828	38898	5556 	1800
			31388	38836	5657 	1800
			31949	38771	5758 	1800
			32509	38715	5859 	1800
			33070	38655	5960 	1800
			33630	38588	6061 	1800
			34191	38511	6162 	1800
			34751	38416	6263 	1800
			35312	38338	6364 	1800
			35872	38293	6465 	1800
			36433	38230	6566 	1800
			36993	38133	6667 	1600
			37554	38059	6768 	1600
			38114	37976	6869 	1600
			38675	37883	6970 	1580
			39235	37779	7071 	1560
			39796	37669	7172 	1540
			40356	37565	7273 	1520
			40917	37459	7374 	1500
			41477	37341	7475 	1480
			42038	37250	7576 	1460
			42598	37199	7677 	1440
			43159	37159	7778 	1420
			43719	37118	7879 	1400
			44280	37081	7980 	1400
			44840	37026	8081 	1400
			45401	36906	8182 	1400
			45961	36719	8283 	1400
			46522	36579	8384 	1400
			47082	36449	8485 	1400
			47643	36314	8586 	1400
			48203	36172	8687 	1400
			48764	36011	8788 	1400
			49324	35832	8889 	1350
			49885	35638	8990 	1300
			50445	35428	9091 	1250
			51006	35209	9192 	1200
			51566	34984	9293 	1200
			52127	34752	9394 	1100
			52687	34515	9495 	1100
			53248	34272	9596 	1100
			53808	34020	9697 	1000
			54369	33751	9798 	800
			54929	33472	9899 	800
			55490	33271	10000 	700
			>;
		bat0-ocv-table-t4-temperature = <(-10)>;
		bat0-ocv-table-t4-qmax = <5369>;
		bat0-ocv-table-t4-size = <100>;
		bat0-ocv-table-t4 = <
			0		44822	0 		3500
			542		44560	101 	3500
			1085	44393	202 	3500
			1627	44264	303 	3500
			2169	44161	404 	3500
			2712	44068	505 	3500
			3254	43977	606 	3500
			3796	43895	707 	3500
			4339	43808	808 	3500
			4881	43718	909 	3500
			5423	43630	1010 	3500
			5966	43537	1111 	3500
			6508	43445	1212 	3500
			7050	43352	1313 	3500
			7593	43260	1414 	3500
			8135	43159	1515 	3500
			8677	43057	1616 	3500
			9219	42956	1717 	3500
			9762	42849	1818 	3500
			10304	42743	1919 	3500
			10846	42635	2020 	3500
			11389	42525	2121 	3500
			11931	42416	2222 	3500
			12473	42300	2323 	3500
			13016	42188	2424 	3500
			13558	42081	2525 	3500
			14100	41966	2626 	3500
			14643	41853	2727 	3500
			15185	41735	2828 	3500
			15727	41624	2929 	3500
			16270	41510	3030 	3500
			16812	41395	3131 	3500
			17354	41283	3232 	3500
			17897	41160	3333 	3500
			18439	41040	3434 	3500
			18981	40911	3535 	3500
			19524	40777	3636 	3500
			20066	40635	3737 	3500
			20608	40495	3838 	3500
			21151	40349	3939 	3500
			21693	40213	4040 	3500
			22235	40087	4141 	3500
			22778	39969	4243 	3500
			23320	39862	4343 	3500
			23862	39761	4444 	3400
			24405	39667	4546 	3350
			24947	39580	4646 	3300
			25489	39492	4747 	3250
			26032	39408	4849 	3200
			26574	39333	4950 	3150
			27116	39252	5050 	3100
			27658	39180	5151 	3050
			28201	39103	5253 	3000
			28743	39036	5354 	3000
			29285	38968	5454 	3000
			29828	38905	5556 	3000
			30370	38835	5657 	3000
			30912	38775	5757 	3000
			31455	38712	5859 	3000
			31997	38651	5960 	3000
			32539	38594	6061 	3000
			33082	38535	6162 	3000
			33624	38474	6263 	3000
			34166	38416	6364 	3000
			34709	38357	6465 	3000
			35251	38297	6566 	2900
			35793	38229	6667 	2800
			36336	38168	6768 	2700
			36878	38093	6869 	2600
			37420	38021	6970 	2500
			37963	37943	7071 	2500
			38505	37864	7172 	2500
			39047	37780	7273 	2500
			39590	37684	7374 	2500
			40132	37585	7475 	2500
			40674	37497	7576 	2500
			41217	37406	7677 	2500
			41759	37304	7778 	2500
			42301	37209	7879 	2500
			42844	37153	7980 	2500
			43386	37108	8081 	2500
			43928	37068	8182 	2500
			44471	37035	8283 	2500
			45013	37001	8384 	2500
			45555	36943	8485 	2500
			46097	36803	8586 	2500
			46640	36576	8687 	2500
			47182	36375	8788 	2500
			47724	36222	8889 	2500
			48267	36070	8990 	2500
			48809	35913	9091 	2500
			49351	35736	9192 	2500
			49894	35550	9293 	2500
			50436	35347	9394 	2500
			50978	35122	9495 	2500
			51521	34886	9596 	2500
			52063	34643	9697 	2500
			52605	34390	9798 	2500
			53148	34137	9899 	2500
			53690	33940	10000 	2500
			>;
		bat0-ocv-table-t5-temperature = <(-20)>;
		bat0-ocv-table-t5-qmax = <4854>;
		bat0-ocv-table-t5-size = <100>;
		bat0-ocv-table-t5 = <
			0		44779	0 		3450
			490		44506	101 	3450
			981		44318	202 	3450
			1471	44171	303 	3450
			1961	44051	404 	3450
			2452	43932	505 	3450
			2942	43822	606 	3475
			3432	43723	707 	3500
			3923	43620	808 	3525
			4413	43526	909 	3550
			4903	43428	1010 	3575
			5394	43329	1111 	3600
			5884	43235	1212 	3625
			6374	43133	1313 	3650
			6865	43034	1414 	3700
			7355	42933	1515 	3730
			7845	42834	1616 	3760
			8336	42733	1717 	3790
			8826	42633	1818 	3820
			9316	42528	1919 	3850
			9807	42424	2020 	3880
			10297	42321	2121 	3910
			10787	42221	2222 	3940
			11278	42116	2323 	3970
			11768	42015	2424 	4000
			12258	41913	2525 	4100
			12749	41814	2626 	4200
			13239	41710	2727 	4300
			13729	41605	2828 	4400
			14220	41501	2929 	4500
			14710	41391	3030 	4600
			15200	41286	3131 	4700
			15691	41179	3232 	4800
			16181	41073	3333 	5000
			16671	40967	3434 	4900
			17162	40856	3535 	4800
			17652	40742	3636 	4700
			18142	40635	3737 	4600
			18633	40518	3838 	4500
			19123	40405	3939 	4500
			19613	40288	4040 	4500
			20104	40181	4141 	4500
			20594	40073	4242 	4500
			21084	39963	4343 	4500
			21575	39866	4445 	4580
			22065	39763	4545 	4660
			22555	39676	4646 	4740
			23046	39587	4748 	4820
			23536	39502	4848 	4900
			24026	39422	4949 	4980
			24517	39340	5051 	5060
			25007	39266	5152 	5140
			25497	39195	5252 	5220
			25988	39124	5354 	5300
			26478	39050	5455 	5380
			26968	38989	5555 	5500
			27459	38926	5657 	5475
			27949	38862	5758 	5450
			28439	38795	5859 	5425
			28930	38741	5960 	5400
			29420	38684	6061 	5375
			29910	38623	6162 	5350
			30401	38570	6263 	5325
			30891	38510	6364 	5300
			31381	38464	6465 	5275
			31872	38411	6566 	5250
			32362	38357	6667 	5225
			32852	38304	6768 	5200
			33343	38257	6869 	5175
			33833	38200	6970 	5150
			34323	38151	7071 	5125
			34814	38099	7172 	5100
			35304	38045	7273 	5075
			35794	37994	7374 	5050
			36285	37943	7475 	5000
			36775	37886	7576 	5000
			37265	37833	7677 	5000
			37756	37773	7778 	5000
			38246	37715	7879 	5000
			38736	37655	7980 	5000
			39227	37591	8081 	5000
			39717	37518	8182 	5000
			40207	37456	8283 	5000
			40698	37382	8384 	5000
			41188	37303	8485 	5000
			41678	37233	8586 	5000
			42169	37178	8687 	5000
			42659	37130	8788 	5000
			43149	37088	8889 	5000
			43640	37048	8990 	5000
			44130	37010	9091 	5300
			44620	36967	9192 	5600
			45111	36890	9293 	5900
			45601	36761	9394 	6200
			46091	36553	9495 	6500
			46582	36305	9596 	6800
			47072	36059	9697 	7100
			47562	35834	9798 	7500
			48053	35627	9899 	7500
			48543	35416	10000 	7500
			>;
	};

&low_battery_throttling {
	compatible = "mediatek,low_battery_throttling";
	lvsys-thd-enable = <1>;
	vbat-thd-enable = <1>;
	bat0-thd-volts-l = <
		3300 3050 2850
		3350 3100 2900
		3420 3200 3000
		3560 3400 3200
		3800 3550 3350>;
	bat0-thd-volts-h = <
		3400 3300 3050
		3450 3350 3100
		3520 3420 3200
		3660 3560 3400
		3900 3800 3550>;
	bat1-thd-volts-l = <
		3300 3050 2850
		3350 3100 2900
		3420 3200 3000
		3560 3400 3200
		3800 3550 3350>;
	bat1-thd-volts-h = <
		3400 3300 3050
		3450 3350 3100
		3520 3420 3200
		3660 3560 3400
		3900 3800 3550>;
	lvsys-thd-volt-l = <2850>;
	lvsys-thd-volt-h = <3100>;

	temperature-stage-threshold = <25 10 0 (-10)>;
	bat0-aging-threshold = <500 1000>;
	bat0-aging-volts-t0 =  <0 0>;
	bat0-aging-volts-t1 =  <0 0>;
	bat0-aging-volts-t2 =  <0 0>;
	bat0-aging-volts-t3 =  <0 0>;
	bat0-aging-volts-t4 =  <0 0>;
	bat1-aging-threshold = <500 1000>;
	bat1-aging-volts-t0 =  <0 0>;
	bat1-aging-volts-t1 =  <0 0>;
	bat1-aging-volts-t2 =  <0 0>;
	bat1-aging-volts-t3 =  <0 0>;
	bat1-aging-volts-t4 =  <0 0>;
	pt-shutdown-enable = <0>;
	throttle-level =  <0 1 2 3>,
			  <0 1 2 3>,
			  <0 1 2 3>,
			  <0 2 4 3>,
			  <0 2 4 3>;
	bootmode = <&chosen>;
	gauge = <&mtk_gauge>;
};

