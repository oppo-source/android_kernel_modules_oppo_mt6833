// SPDX-License-Identifier: GPL-2.0-only
/*
* Copyright (C) 2021-2020 Oplus. All rights reserved.
*/
#include <dt-bindings/iio/mt635x-auxadc.h>
#include <dt-bindings/pinctrl/mt6991-pinfunc.h>
#include <dt-bindings/pinctrl/mt65xx.h>

&peak_power_budget {
	compatible = "mediatek,peak_power_budget";
	bootmode = <&chosen>;
	gauge = <&mtk_gauge>;
	reg = <0 0x00117700 0 0x100>,
		<0 0x13020170 0 0xc>,
		<0 0x4b840c18 0 0x8>,
		<0 0x0c220c04 0 0x20>;
	reg-names = "ppb_sram",
		"hpt_ctrl","gpu_dbg", "cpu_dbg";

	ppb-version = <2>;
	soc-error = <500>;
	battery-circult-rdc  = <39>;
	battery0-path-rac-t0 = <57>;
	battery0-path-rac-t1 = <59>;
	battery0-path-rac-t2 = <63>;
	battery0-path-rac-t3 = <65>;
	battery1-path-rac-t0 = <57>;
	battery1-path-rac-t1 = <59>;
	battery1-path-rac-t2 = <63>;
	battery1-path-rac-t3 = <65>;
	battery2-path-rac-t0 = <57>;
	battery2-path-rac-t1 = <59>;
	battery2-path-rac-t2 = <63>;
	battery2-path-rac-t3 = <65>;
	temperature-threshold = <25 10 0>;
	system-ocp = <15000>;
	system-uvlo = <2400>;

	soc-max-level = <2>;
	soc-hpt-ctrl-lv1 = <7>;
	soc-hpt-ctrl-lv2 = <0>;

	bat-ocv-table-num = <6>;
	bat0-ocv-table-t0-temperature = <50>;
	bat0-ocv-table-t0-qmax = <5561>;
	bat0-ocv-table-t0-size = <100>;
	bat0-ocv-table-t0 = <
			0		44531	0		330
			562		44358	101		326
			1123	44231	202		327
			1685	44118	303		326
			2247	44014	404		326
			2808	43916	505		325
			3370	43820	606		327
			3932	43719	707		338
			4494	43615	808		326
			5055	43514	909		334
			5617	43406	1010	339
			6179	43299	1111	325
			6740	43191	1212	337
			7302	43094	1313	380
			7864	42964	1414	336
			8425	42840	1515	326
			8987	42725	1616	342
			9549	42608	1717	340
			10111	42482	1818	340
			10672	42366	1919	352
			11234	42238	2020	342
			11796	42121	2121	347
			12357	42000	2222	344
			12919	41880	2323	362
			13481	41762	2424	370
			14042	41635	2525	355
			14604	41519	2626	365
			15166	41402	2727	370
			15727	41290	2828	391
			16289	41172	2929	392
			16851	41057	3030	420
			17413	40941	3131	424
			17974	40825	3232	475
			18536	40660	3333	420
			19098	40446	3434	364
			19659	40272	3535	338
			20221	40143	3636	326
			20783	40030	3737	326
			21344	39931	3838	332
			21906	39835	3939	331
			22468	39736	4040	312
			23029	39649	4141	325
			23591	39562	4242	339
			24153	39475	4343	325
			24715	39393	4445	325
			25276	39314	4545	327
			25838	39237	4646	342
			26400	39158	4748	325
			26961	39088	4848	355
			27523	39014	4949	350
			28085	38943	5051	350
			28646	38876	5151	350
			29208	38804	5252	350
			29770	38733	5354	350
			30332	38623	5455	350
			30893	38488	5555	350
			31455	38369	5657	350
			32017	38270	5758	350
			32578	38182	5859	350
			33140	38091	5960	350
			33702	38001	6061	350
			34263	37913	6162	350
			34825	37835	6263	340
			35387	37743	6364	365
			35948	37634	6465	369
			36510	37528	6566	372
			37072	37427	6667	371
			37634	37325	6768	403
			38195	37223	6869	381
			38757	37153	6970	372
			39319	37107	7071	369
			39880	37063	7172	367
			40442	37015	7273	373
			41004	36961	7374	409
			41565	36868	7475	483
			42127	36738	7576	698
			42689	36630	7677	778
			43250	36510	7778	809
			43812	36368	7879	812
			44374	36215	7980	832
			44936	36061	8081	886
			45497	35883	8182	909
			46059	35701	8283	931
			46621	35506	8384	990
			47182	35311	8485	1048
			47744	35126	8586	1122
			48306	34934	8687	1100
			48867	34755	8788	1100
			49429	34555	8889	1100
			49991	34344	8990	1000
			50553	34106	9091	1000
			51114	33845	9192	1000
			51676	33556	9293	800
			52238	33245	9394	700
			52799	32922	9495	600
			53361	32594	9596	500
			53923	32250	9697	310
			54484	31842	9798	310
			55046	31269	9899	310
			55608	31032	10000	310
			>;
		bat0-ocv-table-t1-temperature = <25>;
		bat0-ocv-table-t1-qmax = <5461>;
		bat0-ocv-table-t1-size = <100>;
		bat0-ocv-table-t1 = <
			0		44655	0		530
			552		44469	101		534
			1103	44330	202		532
			1655	44221	303		554
			2206	44116	404		536
			2758	44016	505		516
			3310	43926	606		539
			3861	43827	707		539
			4413	43726	808		529
			4964	43629	909		543
			5516	43526	1010	543
			6067	43423	1111	547
			6619	43316	1212	549
			7171	43205	1313	529
			7722	43093	1414	534
			8274	42977	1515	532
			8825	42863	1616	556
			9377	42739	1717	534
			9929	42622	1818	555
			10480	42503	1919	558
			11032	42378	2020	548
			11583	42263	2121	575
			12135	42134	2222	553
			12687	42015	2323	568
			13238	41891	2424	568
			13790	41776	2525	605
			14341	41650	2626	591
			14893	41536	2727	621
			15444	41420	2828	634
			15996	41303	2929	653
			16548	41187	3030	659
			17099	41079	3131	695
			17651	40960	3232	722
			18202	40840	3333	755
			18754	40699	3434	759
			19306	40505	3535	667
			19857	40292	3636	555
			20409	40136	3737	531
			20960	40016	3838	526
			21512	39907	3939	528
			22064	39807	4041	519
			22615	39712	4141	527
			23167	39625	4242	513
			23718	39536	4343	518
			24270	39452	4444	524
			24821	39369	4545	512
			25373	39292	4646	523
			25925	39209	4748	514
			26476	39137	4848	527
			27028	39066	4950	528
			27579	38995	5050	540
			28131	38922	5152	527
			28683	38859	5253	557
			29234	38791	5354	558
			29786	38727	5455	582
			30337	38654	5556	574
			30889	38575	5657	566
			31441	38471	5758	519
			31992	38381	5859	539
			32544	38286	5960	528
			33095	38192	6061	513
			33647	38098	6162	513
			34198	38013	6263	513
			34750	37939	6364	538
			35302	37849	6465	531
			35853	37745	6566	512
			36405	37640	6667	538
			36956	37537	6768	539
			37508	37429	6869	529
			38060	37321	6970	551
			38611	37227	7071	543
			39163	37174	7172	540
			39714	37126	7273	528
			40266	37089	7374	529
			40817	37044	7475	565
			41369	36978	7576	585
			41921	36846	7677	700
			42472	36725	7778	750
			43024	36605	7879	800
			43575	36469	7980	850
			44127	36328	8081	900
			44679	36174	8182	950
			45230	36005	8283	1000
			45782	35820	8384	1000
			46333	35635	8485	1000
			46885	35434	8586	1000
			47437	35241	8687	1000
			47988	35037	8788	1000
			48540	34845	8889	1000
			49091	34642	8990	1000
			49643	34429	9091	1000
			50194	34194	9192	1000
			50746	33924	9293	1000
			51298	33641	9394	800
			51849	33314	9495	750
			52401	32991	9596	700
			52952	32651	9697	600
			53504	32316	9798	500
			54056	31916	9899	500
			54607	31398	10000	500
			>;

		bat0-ocv-table-t2-temperature = <10>;
		bat0-ocv-table-t2-qmax = <5405>;
		bat0-ocv-table-t2-size = <100>;
		bat0-ocv-table-t2 = <
			0		44704	0	    1150
			546		44496	101 	1150
			1092	44362	202	 	1150
			1638	44246	303		1150
			2184	44153	404		1150
			2730	44059	505		1150
			3275	43967	606		1130
			3821	43874	707		1130
			4367	43780	808		1130
			4913	43681	909		1130
			5459	43584	1010	1130
			6005	43483	1111	1130
			6551	43381	1212	1130
			7097	43271	1313	1130
			7643	43166	1414	1130
			8189	43056	1515	1130
			8735	42941	1616	1130
			9281	42822	1717	1130
			9826	42704	1818	1120
			10372	42591	1919	1120
			10918	42466	2020	1120
			11464	42347	2121	1120
			12010	42224	2222	1120
			12556	42110	2323	1120
			13102	41984	2424	1120
			13648	41869	2525	1120
			14194	41751	2626	1120
			14740	41633	2727	1120
			15286	41520	2828	1120
			15831	41402	2929	1120
			16377	41289	3030	1120
			16923	41173	3131	1120
			17469	41059	3232	1120
			18015	40941	3333	1000
			18561	40818	3434	1000
			19107	40678	3535	1000
			19653	40506	3636	1000
			20199	40314	3737	1000
			20745	40143	3838	1000
			21291	40008	3939	1000
			21837	39898	4041	1000
			22382	39800	4141	1000
			22928	39702	4242	1000
			23474	39610	4343	1000
			24020	39527	4444	1000
			24566	39442	4545	1000
			25112	39362	4646	1000
			25658	39280	4748	1000
			26204	39207	4849	1000
			26750	39129	4950	1000
			27296	39065	5051	1000
			27842	38995	5152	1000
			28387	38924	5252	1000
			28933	38861	5354	1000
			29479	38793	5455	1000
			30025	38733	5556	1000
			30571	38668	5657	1000
			31117	38609	5758	1000
			31663	38537	5859	1000
			32209	38475	5960	1000
			32755	38402	6061	1000
			33301	38318	6162	1000
			33847	38225	6263	1000
			34392	38127	6364	1000
			34938	38043	6465	1000
			35484	37963	6566	1000
			36030	37884	6667	1000
			36576	37783	6768	1000
			37122	37672	6869	1000
			37668	37574	6970	1000
			38214	37472	7071	1000
			38760	37366	7172	1000
			39306	37260	7273	1060
			39852	37194	7374	1060
			40398	37149	7475	1060
			40943	37111	7576	1060
			41489	37064	7677	1060
			42035	37022	7778	1060
			42581	36926	7879	1100
			43127	36765	7980	1150
			43673	36630	8081	1150
			44219	36500	8182	1150
			44765	36360	8283	1350
			45311	36215	8384	1400
			45857	36056	8485	1400
			46403	35881	8586	1400
			46948	35688	8687	1300
			47494	35489	8788	1250
			48040	35280	8889	1250
			48586	35077	8990	1100
			49132	34874	9091	1100
			49678	34664	9192	1000
			50224	34450	9293	1000
			50770	34225	9394	1000
			51316	33975	9495	1000
			51862	33708	9596	800
			52408	33409	9697	800
			52954	33104	9798	700
			53499	32774	9899	700
			54045	32452	10000	700
			>;
		bat0-ocv-table-t3-temperature = <0>;
		bat0-ocv-table-t3-qmax = <5120>;
		bat0-ocv-table-t3-size = <100>;
		bat0-ocv-table-t3 = <
			0		44729	0		2400
			517		44515	101		2656
			1034	44373	202		2649
			1551	44256	303		2622
			2069	44164	404		2631
			2586	44071	505		2606
			3103	43983	606		2594
			3620	43894	707		2572
			4137	43803	808		2558
			4654	43714	909		2558
			5171	43624	1010	2544
			5688	43528	1111	2539
			6206	43429	1212	2519
			6723	43335	1313	2525
			7240	43227	1414	2514
			7757	43128	1515	2521
			8274	43020	1616	2501
			8791	42914	1717	2496
			9308	42797	1818	2485
			9826	42690	1919	2496
			10343	42572	2020	2483
			10860	42459	2121	2481
			11377	42343	2222	2482
			11894	42228	2323	2482
			12411	42116	2424	2496
			12928	42002	2525	2493
			13445	41885	2626	2463
			13963	41772	2727	2433
			14480	41654	2828	2403
			14997	41542	2929	2373
			15514	41425	3030	2343
			16031	41311	3131	2313
			16548	41196	3232	2283
			17065	41085	3333	2200
			17583	40969	3434	2120
			18100	40832	3535	2040
			18617	40693	3636	1960
			19134	40533	3737	1880
			19651	40366	3838	1800
			20168	40211	3939	1800
			20685	40071	4040	1800
			21202	39954	4141	1800
			21720	39851	4243	1800
			22237	39751	4344	1800
			22754	39664	4444	1800
			23271	39581	4545	1800
			23788	39522	4646	1800
			24305	39458	4747	1800
			24822	39393	4848	1800
			25340	39317	4950	1800
			25857	39253	5051	1800
			26374	39184	5152	1800
			26891	39117	5253	1800
			27408	39049	5354	1800
			27925	38984	5455	1800
			28442	38921	5556	1800
			28960	38859	5657	1800
			29477	38794	5758	1800
			29994	38734	5859	1800
			30511	38674	5960	1800
			31028	38606	6061	1800
			31545	38525	6162	1800
			32062	38431	6263	1800
			32579	38346	6364	1800
			33097	38266	6465	1800
			33614	38173	6566	1800
			34131	38090	6667	1600
			34648	38010	6768	1600
			35165	37932	6869	1600
			35682	37889	6970	1580
			36199	37837	7071	1560
			36717	37717	7172	1540
			37234	37609	7273	1520
			37751	37497	7374	1500
			38268	37376	7475	1480
			38785	37284	7576	1460
			39302	37223	7677	1440
			39819	37179	7778	1420
			40336	37144	7879	1400
			40854	37098	7980	1400
			41371	37050	8081	1400
			41888	36945	8182	1400
			42405	36765	8283	1400
			42922	36622	8384	1400
			43439	36502	8485	1400
			43956	36380	8586	1400
			44474	36244	8687	1400
			44991	36093	8788	1400
			45508	35928	8889	1350
			46025	35746	8990	1300
			46542	35549	9091	1250
			47059	35337	9192	1200
			47576	35120	9293	1200
			48093	34896	9394	1100
			48611	34672	9495	1100
			49128	34432	9596	1100
			49645	34190	9697	1000
			50162	33936	9798	800
			50679	33668	9899	800
			51196	33389	10000	700
			>;
		bat0-ocv-table-t4-temperature = <(-10)>;
		bat0-ocv-table-t4-qmax = <4942>;
		bat0-ocv-table-t4-size = <100>;
		bat0-ocv-table-t4 = <
			0		44822	0		3500
			499		44567	101		3500
			998		44397	202		3500
			1498	44273	303		3500
			1997	44170	404		3500
			2496	44079	505		3500
			2995	43994	606		3500
			3494	43908	707		3500
			3993	43823	808		3500
			4493	43737	909		3500
			4992	43648	1010	3500
			5491	43560	1111	3500
			5990	43475	1212	3500
			6489	43380	1313	3500
			6988	43282	1414	3500
			7488	43184	1515	3500
			7987	43089	1616	3500
			8486	42989	1717	3500
			8985	42884	1818	3500
			9484	42781	1919	3500
			9983	42673	2020	3500
			10483	42560	2121	3500
			10982	42452	2222	3500
			11481	42346	2323	3500
			11980	42232	2424	3500
			12479	42119	2525	3500
			12978	42011	2626	3500
			13478	41895	2727	3500
			13977	41784	2828	3500
			14476	41670	2929	3500
			14975	41557	3030	3500
			15474	41441	3131	3500
			15973	41324	3232	3500
			16473	41204	3333	3500
			16972	41079	3434	3500
			17471	40953	3535	3500
			17970	40814	3636	3500
			18469	40676	3737	3500
			18968	40537	3838	3500
			19468	40394	3939	3500
			19967	40256	4040	3500
			20466	40134	4141	3500
			20965	40017	4242	3500
			21464	39911	4343	3500
			21964	39804	4445	3400
			22463	39711	4546	3350
			22962	39622	4646	3300
			23461	39531	4747	3250
			23960	39451	4848	3200
			24459	39370	4949	3150
			24959	39293	5051	3100
			25458	39218	5152	3050
			25957	39147	5253	3000
			26456	39074	5354	3000
			26955	39012	5454	3000
			27454	38939	5555	3000
			27954	38874	5657	3000
			28453	38807	5758	3000
			28952	38749	5859	3000
			29451	38684	5960	3000
			29950	38627	6061	3000
			30449	38565	6162	3000
			30949	38507	6263	3000
			31448	38452	6364	3000
			31947	38384	6465	3000
			32446	38325	6566	2900
			32945	38258	6667	2800
			33444	38192	6768	2700
			33944	38122	6869	2600
			34443	38046	6970	2500
			34942	37968	7071	2500
			35441	37889	7172	2500
			35940	37797	7273	2500
			36439	37700	7374	2500
			36939	37604	7475	2500
			37438	37511	7576	2500
			37937	37420	7677	2500
			38436	37315	7778	2500
			38935	37223	7879	2500
			39435	37167	7980	2500
			39934	37119	8081	2500
			40433	37079	8182	2500
			40932	37048	8283	2500
			41431	37011	8384	2500
			41930	36947	8485	2500
			42430	36798	8586	2500
			42929	36572	8687	2500
			43428	36376	8788	2500
			43927	36221	8889	2500
			44426	36073	8990	2500
			44925	35921	9091	2500
			45425	35754	9192	2500
			45924	35572	9293	2500
			46423	35372	9394	2500
			46922	35158	9495	2500
			47421	34935	9596	2500
			47920	34692	9697	2500
			48420	34447	9798	2500
			48919	34206	9899	2500
			49418	33953	10000	2500
			>;
		bat0-ocv-table-t5-temperature = <(-20)>;
		bat0-ocv-table-t5-qmax = <4523>;
		bat0-ocv-table-t5-size = <100>;
		bat0-ocv-table-t5 = <
			0		44742	0		3450
			457		44483	101		3450
			914		44302	202		3450
			1371	44158	303		3450
			1827	44031	404		3450
			2284	43919	505		3450
			2741	43813	606		3475
			3198	43707	707		3500
			3655	43608	808		3525
			4112	43511	909		3550
			4569	43419	1010	3575
			5025	43323	1111	3600
			5482	43229	1212	3625
			5939	43127	1313	3650
			6396	43032	1414	3700
			6853	42933	1515	3730
			7310	42835	1616	3760
			7767	42733	1717	3790
			8223	42633	1818	3820
			8680	42533	1919	3850
			9137	42437	2020	3880
			9594	42333	2121	3910
			10051	42228	2222	3940
			10508	42129	2323	3970
			10965	42029	2424	4000
			11421	41930	2525	4100
			11878	41827	2626	4200
			12335	41726	2727	4300
			12792	41622	2828	4400
			13249	41527	2929	4500
			13706	41421	3030	4600
			14163	41315	3131	4700
			14619	41206	3232	4800
			15076	41093	3333	5000
			15533	40989	3434	4900
			15990	40879	3535	4800
			16447	40766	3636	4700
			16904	40665	3737	4600
			17360	40549	3838	4500
			17817	40435	3939	4500
			18274	40325	4040	4500
			18731	40217	4141	4500
			19188	40110	4242	4500
			19645	40005	4343	4500
			20102	39905	4444	4450
			20558	39808	4545	4400
			21015	39716	4646	4350
			21472	39624	4747	4300
			21929	39542	4848	4250
			22386	39464	4949	4200
			22843	39380	5051	4150
			23300	39308	5152	4100
			23756	39235	5252	4050
			24213	39165	5353	4000
			24670	39095	5454	3950
			25127	39032	5556	4000
			25584	38968	5657	4000
			26041	38904	5758	4000
			26498	38841	5859	4000
			26954	38785	5959	4000
			27411	38725	6060	4000
			27868	38666	6162	4000
			28325	38613	6263	4000
			28782	38559	6364	4000
			29239	38502	6465	4000
			29696	38452	6566	4000
			30152	38397	6667	4000
			30609	38347	6768	4000
			31066	38298	6869	4000
			31523	38243	6970	4000
			31980	38192	7071	4000
			32437	38142	7172	4000
			32894	38087	7273	4000
			33350	38035	7374	4000
			33807	37979	7475	4000
			34264	37922	7576	4200
			34721	37870	7677	4400
			35178	37804	7778	4500
			35635	37747	7879	4600
			36092	37688	7980	4850
			36548	37619	8081	5100
			37005	37552	8182	5350
			37462	37485	8283	5600
			37919	37412	8384	5850
			38376	37334	8485	6100
			38833	37263	8586	6350
			39290	37201	8687	6600
			39746	37154	8788	6850
			40203	37113	8889	7100
			40660	37074	8990	7000
			41117	37037	9091	7000
			41574	36996	9192	7000
			42031	36928	9293	7000
			42488	36819	9394	7000
			42944	36622	9495	7000
			43401	36370	9596	7000
			43858	36126	9697	7000
			44315	35899	9798	7400
			44772	35695	9899	7400
			45229	35497	10000	7400
			>;
	};

&low_battery_throttling {
		compatible = "mediatek,low_battery_throttling";
		lvsys-thd-enable = <1>;
		vbat-thd-enable = <1>;
		bat0-thd-volts-l = <
			3270 3050 2850
			3340 3100 2900
			3440 3200 3000
			3600 3400 3200
			3800 3550 3350>;
		bat0-thd-volts-h = <
			3370 3270 3050
			3440 3340 3100
			3540 3440 3200
			3700 3600 3400
			3900 3800 3550>;
		bat1-thd-volts-l = <
			3170 3000 2850
			3240 3150 2850
			3310 3210 2850
			3460 3260 2850
			3670 3320 2850>;
		bat1-thd-volts-h = <
			3270 3170 3000
			3340 3240 3150
			3410 3310 3210
			3560 3460 3260
			3770 3670 3320>;
		lvsys-thd-volt-l = <2850>;
		lvsys-thd-volt-h = <3100>;

		temperature-stage-threshold = <25 10 0 (-10)>;
		bat0-aging-threshold = <500 1000>;
		bat0-aging-volts-t0 =  <0 0>;
		bat0-aging-volts-t1 =  <0 0>;
		bat0-aging-volts-t2 =  <0 0>;
		bat0-aging-volts-t3 =  <0 0>;
		bat0-aging-volts-t4 =  <0 0>;
		bat1-aging-threshold = <500 1000>;
		bat1-aging-volts-t0 =  <0 0>;
		bat1-aging-volts-t1 =  <0 0>;
		bat1-aging-volts-t2 =  <0 0>;
		bat1-aging-volts-t3 =  <0 0>;
		bat1-aging-volts-t4 =  <0 0>;
		pt-shutdown-enable = <0>;
		throttle-level =  <0 1 2 3>,
				  <0 1 2 3>,
				  <0 1 2 3>,
				  <0 2 4 3>,
				  <0 2 4 3>;
		bootmode = <&chosen>;
		gauge = <&mtk_gauge>;
};

